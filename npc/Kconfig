## npc/Kconfig
```kconfig
mainmenu "NPC Configuration Menu"

choice
  prompt "Base ISA"
  default ISA_riscv
config ISA_riscv
  bool "riscv"
endchoice

config ISA
  string
  default "riscv32" if ISA_riscv && !RV64
  default "riscv64" if ISA_riscv &&  RV64
  default "none"

config ISA64
  depends on ISA_riscv && RV64
  bool
  default y


if ISA_riscv
menu "ISA-dependent Options for riscv"

config RV64
  bool "64-bit RISC-V architecture"
  default n

config RVE
  bool "Use E extension"
  default n
endmenu
endif

choice
  prompt "NPC execution engine"
  default ENGINE_INTERPRETER

config ENGINE_INTERPRETER
  bool "Interpreter"
  help
    Interpreter guest instructions one by one.
endchoice

config ENGINE
  string
  default "interpreter" if ENGINE_INTERPRETER
  default "none"

choice
  prompt "Running mode"
  default MODE_SYSTEM

config MODE_SYSTEM
  bool "System mode"
  help
    Support full-system functionality, including privileged instructions, MMU and devices.
endchoice

choice
  prompt "Build target"
  default TARGET_NATIVE_ELF
config TARGET_NATIVE_ELF
  bool "Executable on Linux Native"
config TARGET_SHARE
  bool "Shared object (used as REF for differential testing)"
config TARGET_AM
  bool "Application on Abstract-Machine (DON'T CHOOSE)"
endchoice

menu "Build Options"
choice 
  prompt "Verilog Compiler"
  default VERILOG_VERILATOR
config VERILOG_VERILATOR
  bool "verilator"
endchoice

config VERILOG_COMPILER
  string 
  default "verilator" if VERILOG_VERILATOR
  default "none"
endmenu

menu "Testing and Debugging"
config TRACE
  bool "Enable tracer"
  default y

config TRACE_START
  depends on TRACE
  int "When tracing is enabled (unit: number of instructions)"
  default 0

config TRACE_END
  depends on TRACE
  int "When tracing is disabled (unit: number of instructions)"
  default 10000

config ITRACE
  depends on TRACE && TARGET_NATIVE_ELF && ENGINE_INTERPRETER
  bool "Enable instruction tracer"
  default y

config ITRACE_COND
  depends on ITRACE
  string "tracing the instructions to log_file when the condition is true"
  default "true"

config MTRACE
  depends on TRACE && TARGET_NATIVE_ELF && ENGINE_INTERPRETER
  bool "Enable memory read or write trace"
  default n

config FTRACE
  depends on TRACE && TARGET_NATIVE_ELF && ENGINE_INTERPRETER
  bool "Enable function call or return trace"
  default n

config WATCHPOINT
  depends on TARGET_NATIVE_ELF
  bool "Enable the debug function--watchpoint"
  default y

config VCD
  depends on TARGET_NATIVE_ELF
	bool "Enable vcd print"
	default n
config VCD_START
	depends on VCD
	hex "The Start VCD sim times"
	default 0x0
config VCD_END
	depends on VCD
	hex "The End VCD sim times"
	default 0xFFFFFFFF

config DIFFTEST
  depends on TARGET_NATIVE_ELF
  bool "Enable differential testing"
  default n
  help
    Enable differential testing with a reference design.
    Note that this will significantly reduce the performance of NEMU.

choice
  prompt "Reference design"
  default DIFFTEST_REF_NEMU
  depends on DIFFTEST
config DIFFTEST_REF_NEMU
  bool "NEMU"
endchoice

config DIFFTEST_REF_PATH
  string
  default "$(NEMU_HOME)/build/riscv32-nemu-interpreter-so" if DIFFTEST_REF_NEMU
  default "none"

config DIFFTEST_REF_NAME
  string
  default "nemu" if DIFFTEST_REF_NEMU
  default "none"
endmenu

if MODE_SYSTEM
source "csrc/memory/Kconfig"
source "csrc/device/Kconfig"
endif


menu "Miscellaneous"
choice
  depends on !TARGET_AM
  prompt "Host timer"
  default TIMER_GETTIMEOFDAY
config TIMER_GETTIMEOFDAY
  bool "gettimeofday"
config TIMER_CLOCK_GETTIME
  bool "clock_gettime"
endchoice

config RT_CHECK
  bool "Enable runtime checking"
  default y

endmenu
```
